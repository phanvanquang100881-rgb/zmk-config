/ {
    chosen {
        zmk,kscan = &kscan0;
    };

    kscan0: kscan {
        compatible = "zmk,kscan-gpio-matrix";
        label = "KSCAN";
        diode-direction = "col2row";

        col-gpios
            = <&gpio0  6 GPIO_ACTIVE_HIGH> // Col 0  (D1)
            , <&gpio0  8 GPIO_ACTIVE_HIGH> // Col 1  (D0)
            , <&gpio0 17 GPIO_ACTIVE_HIGH> // Col 2  (D2)
            , <&gpio0 20 GPIO_ACTIVE_HIGH> // Col 3  (D3)
            , <&gpio0 22 GPIO_ACTIVE_HIGH> // Col 4  (D4)
            , <&gpio0 24 GPIO_ACTIVE_HIGH> // Col 5  (D5)
            , <&gpio0  9 GPIO_ACTIVE_HIGH> // Col 6  (D10) - Chân NFC
            , <&gpio0 10 GPIO_ACTIVE_HIGH> // Col 7  (D16) - Chân NFC
            , <&gpio1 11 GPIO_ACTIVE_HIGH> // Col 8  (D14)
            , <&gpio1 13 GPIO_ACTIVE_HIGH> // Col 9  (D15)
            , <&gpio1 15 GPIO_ACTIVE_HIGH> // Col 10 (D18)
            , <&gpio0  2 GPIO_ACTIVE_HIGH> // Col 11 (D19)
            ;

        row-gpios
            = <&gpio1  1 (GPIO_ACTIVE_HIGH | GPIO_PULL_DOWN)> // Row 0 (P1.01)
            , <&gpio1  4 (GPIO_ACTIVE_HIGH | GPIO_PULL_DOWN)> // Row 1 (D8)
            , <&gpio1  2 (GPIO_ACTIVE_HIGH | GPIO_PULL_DOWN)> // Row 2 (P1.02)
            , <&gpio1  7 (GPIO_ACTIVE_HIGH | GPIO_PULL_DOWN)> // Row 3 (P1.07)
            ;
    };
};
